## v4l-dvb/files/linux/drivers/media/vtunerc/Kconfig
```kconfig
config DVB_VTUNERC
	tristate "Virtual DVB adapters support"
	depends on DVB_CORE
	---help---
	  Support for virtual DVB adapter.

	  Choose Y here if you want to access DVB device residing on other
	  computers using vtuner protocol.  To compile this driver as a module,
	  choose M here: the module will be called vtunerc.

	  To connect remote DVB device, you also need to install the user space
	  vtunerc command which can be found in the Dreamtuner package, available
	  from http://code.google.com/p/dreamtuner/.
```

## v4l-dvb/origin/Config.in
```kconfig
choice
    depends on PACKAGE_kmod-media
    prompt "Used DVB (media) tree"
    default V4L_SRC_TBSDTV

    config V4L_SRC_TBSDTV
        bool "TBS"
        help
            TBS Technologies is a company which specializes in developing, manufacturing and marketing of
            digital TV tuner cards for PC. They maintain a fork of LinuxTV repo for their open source drivers.
            You want to use this if you have a device from TBS.

            Repo: https://github.com/tbsdtv/linux_media

    config V4L_SRC_LINUXTV
        bool "LinuxTV"
        help
            The LinuxTV community develops and maintains the Linux Kernel Media Subsystems.
            Use this if you are unsure.

            Repo: https://git.linuxtv.org/media_tree.git/

endchoice
```
